## sdkconfig.defaults
```kconfig
#
# Partition Table
#
CONFIG_PARTITION_TABLE_CUSTOM=y
CONFIG_PARTITION_TABLE_CUSTOM_FILENAME="partitions.csv"
CONFIG_PARTITION_TABLE_FILENAME="partitions.csv"
CONFIG_PARTITION_TABLE_OFFSET=0x8000
CONFIG_PARTITION_TABLE_MD5=y
# end of Partition Table

#
# mbedTLS
#
CONFIG_MBEDTLS_CMAC_C=y
CONFIG_MBEDTLS_SSL_PROTO_DTLS=y
CONFIG_MBEDTLS_KEY_EXCHANGE_ECJPAKE=y
# end of TLS Key Exchange Methods

CONFIG_MBEDTLS_ECJPAKE_C=y
# end of mbedTLS

#
# OpenThread
#
CONFIG_OPENTHREAD_ENABLED=y
CONFIG_OPENTHREAD_BORDER_ROUTER=y
CONFIG_OPENTHREAD_RADIO_NATIVE=y
CONFIG_OPENTHREAD_NVS_NAMESPACE="ot_storage"
CONFIG_OPENTHREAD_DATASET_IN_NVS=y
# end of OpenThread

#
# lwIP - Optimized for many Thread devices
#
CONFIG_LWIP_IPV6_FORWARD=y
CONFIG_LWIP_IPV6_NUM_ADDRESSES=32
CONFIG_LWIP_MULTICAST_PING=y
CONFIG_LWIP_NETIF_STATUS_CALLBACK=y
CONFIG_LWIP_HOOK_IP6_ROUTE_DEFAULT=y
CONFIG_LWIP_HOOK_ND6_GET_GW_DEFAULT=y
CONFIG_LWIP_HOOK_IP6_INPUT_CUSTOM=y
CONFIG_LWIP_HOOK_IP6_SELECT_SRC_ADDR_CUSTOM=y
CONFIG_LWIP_IPV6_AUTOCONFIG=y
CONFIG_LWIP_IPV6_DHCP6=y
# end of lwIP

#
# mDNS - Optimized for many services
#
CONFIG_MDNS_MULTIPLE_INSTANCE=y
CONFIG_MDNS_MAX_SERVICES=100
CONFIG_MDNS_MAX_INTERFACES=8
CONFIG_MDNS_TIMER_PERIOD_MS=100
CONFIG_MDNS_TASK_PRIORITY=1
CONFIG_MDNS_TASK_STACK_SIZE=4096
CONFIG_MDNS_SERVICE_ADD_TIMEOUT_MS=2000
# end of mDNS

#
# ESP System Settings - Increased for Thread network
#
CONFIG_ESP_SYSTEM_EVENT_TASK_STACK_SIZE=4096
# end of ESP System Settings

# SPIFFS Configuration
CONFIG_SPIFFS_MAX_PARTITIONS=3

# HTTP Server
CONFIG_HTTPD_MAX_REQ_HDR_LEN=1024

# OpenThread Border Router
CONFIG_OPENTHREAD_BR_START_WEB=y

#
# Networking Optimization  
#
CONFIG_LWIP_MAX_SOCKETS=16
CONFIG_LWIP_TCPIP_RECVMBOX_SIZE=64
CONFIG_LWIP_UDP_RECVMBOX_SIZE=64
CONFIG_LWIP_TCP_RECVMBOX_SIZE=64

#
# Memory Optimization
#
CONFIG_ESP_MAIN_TASK_STACK_SIZE=8192
CONFIG_PTHREAD_TASK_STACK_SIZE_DEFAULT=4096
```
